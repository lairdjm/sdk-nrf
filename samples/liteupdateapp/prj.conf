## CMakeLists.txt
```
#
# Copyright (c) 2024 Nordic Semiconductor
#
# SPDX-License-Identifier: LicenseRef-Nordic-5-Clause
#

cmake_minimum_required(VERSION 3.20.0)

find_package(Zephyr REQUIRED HINTS $ENV{ZEPHYR_BASE})
project(mcuboot_update)

# This project uses orginal sdk-zephyr C source code
target_sources(app PRIVATE src/main.c)
#zephyr_link_libraries(MCUBOOT_BOOTUTIL)

set(gen_dir ${ZEPHYR_BINARY_DIR}/include/generated/)

  generate_inc_file_for_target(
    app
    /tmp/dummyinput.bin
    ${gen_dir}/dummyinput.inc
    )
```

## Kconfig
```
config BLAH1
	hex "Alternative flash start address (DO NOT ALTER)"
	default 0x0

config BLAH2
	hex "Alternative flash size (DO NOT ALTER)"
	default 0x0

config BLAH3
	bool "Use alternative flash parameters (DO NOT ALTER)"

config FLASH_LOAD_OFFSET
	default BLAH1 if BLAH3

config FLASH_LOAD_SIZE
	default BLAH2 if BLAH3

source "Kconfig.zephyr"
```

## Kconfig.sysbuild
```
#
# Copyright (c) 2025 Nordic Semiconductor
#
# SPDX-License-Identifier: LicenseRef-Nordic-5-Clause
#

source "${ZEPHYR_BASE}/share/sysbuild/Kconfig"

menu "Partitions"

config FLASH_SIZE
	hex
	default 0x100000 if SOC_SERIES_NRF53X
	default 0x150000 if SOC_SERIES_NRF54LX

config MCUBOOT_SIZE
	hex "Size of MCUboot"
	default 0x8000
	help
	  Specifies the size of the MCUboot partition, set to 0x0 to disable

config FILE_SYSTEM_SIZE
	hex "Size of file system"
	default 0x8000
	help
	  Specifies the size of the file system partition, set to 0x0 to disable

config FIRMWARE_LOADER_SIZE
	hex "Size of firmware loader" if MCUBOOT_SIZE > 0x0
	default 0x0 if MCUBOOT_SIZE = 0x0
	default 0x8000
	help
	  Specifies the size of the firmware loader partition, set to 0x0 to disable

config METADATA_SIZE
	hex
	default 0x200 if MCUBOOT_SIZE > 0x0 || FIRMWARE_LOADER_SIZE > 0x0
	default 0x0
	help
	  Specifies the size of the metadata partition, set to 0x0 to disable

choice SOFTDEVICE_SELECTION
	prompt "Softdevice selection"

config SOFTDEVICE_NONE
	bool "None"

config SOFTDEVICE_S112
	bool "s112"

config SOFTDEVICE_S140
	bool "s140"

endchoice

config SOFTDEVICE_SIZE
	hex
	default 0x4000 if SOFTDEVICE_S112
	default 0x8000 if SOFTDEVICE_S140
	default 0x0
	help
	  Specifies the size of the softdevice partition, set to 0x0 to disable

config INSTALLER_SIZE
	hex
	default 0x8000 if FIRMWARE_LOADER_SIZE > 0x0
	default 0x0
	help
	  Specifies the size of the installer image, set to 0x0 to disable

endmenu
```

## prj.conf
```kconfig
CONFIG_STREAM_FLASH=y
CONFIG_FLASH_MAP=y

# Some command handlers require a large stack.
CONFIG_SYSTEM_WORKQUEUE_STACK_SIZE=2304
CONFIG_MAIN_STACK_SIZE=2048

# Enable most core commands.
CONFIG_FLASH=y
CONFIG_IMG_MANAGER=y

# Enable logging
CONFIG_LOG=y
CONFIG_MCUBOOT_UTIL_LOG_LEVEL_WRN=y

# Disable debug logging
CONFIG_LOG_MAX_LEVEL=3
```

## src/main.c
```c
/*
 * Copyright (c) 2025 Nordic Semiconductor ASA
 *
 * SPDX-License-Identifier: LicenseRef-Nordic-5-Clause
 */

#include <zephyr/kernel.h>
#include <zephyr/storage/flash_map.h>
#include <zephyr/logging/log.h>
//#include <bootutil/image.h>
#include <zephyr/sys/crc.h>

LOG_MODULE_REGISTER(todo, LOG_LEVEL_DBG);

struct image_data {
	uint32_t start_address;
	uint32_t image_size;
	uint8_t reserved[56];
};

struct image_data_array {
	uint8_t image_count;
	uint8_t reserved[31];
	struct image_data images[];
};

static const uint8_t test_data[] = {
#include "lol.inc"
};

static const struct image_data_array *lol = (struct image_data_array *)test_data;

int main(void)
{
	uint8_t i = 0;
	uint32_t checksum_calculated;
	uint32_t checksum_expected;

	checksum_expected = crc32_ieee(test_data, (sizeof(struct image_data) * lol->image_count) + 32);
	memcpy(&checksum_calculated, (test_data + (sizeof(struct image_data) * lol->image_count) + 32), sizeof(checksum_calculated));

	LOG_ERR("checksum (calculated): %u", checksum_calculated);
	LOG_ERR("checksum (expected): %u", checksum_expected);

	if (checksum_calculated == checksum_expected) {
		LOG_ERR("Images: %d", lol->image_count);

		while (i < lol->image_count) {
			LOG_ERR("Image %d:", i);
			LOG_ERR("\tStart address: 0x%x:", lol->images[i].start_address);
			LOG_ERR("\tSize: 0x%x:", lol->images[i].image_size);
			++i;
		}
	} else {
		LOG_ERR("Checksum mismatch");
	}

	return 0;
}
```
